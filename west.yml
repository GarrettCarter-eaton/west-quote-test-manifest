## west.yml
```yaml
manifest:
  remotes:
    - name: github
      url-base: https://github.com/GarrettCarter-eaton
  projects:
    - name: west-quote-test-dep
      remote: github
      revision: bb4143e
self:
    path: west-quote-test-manifest
```
